long 0xb0003000 0x00130456 
long 0xb0003030 0x00001010 
long 0xb0003010 0x00000005 
long 0xb0003004 0x00000021 
long 0xb0003004 0x00000023 
long 0xb0003004 0x00000027 
long 0xb000301C 0x00001002 
long 0xb0003018 0x00000122 
long 0xb0003004 0x00000027 
long 0xb0003004 0x0000002B 
long 0xb0003004 0x0000002B 
long 0xb0003018 0x00000022 
long 0xb0003004 0x00000020 
long 0xb0003034 0x00AAAA00 
long 0xb0003008 0x0000805A 
long 0xb00000A0 0x00000000 
long 0xb0000224 0x0000447E 
long 0xb000020C 0x00000018 
long 0xb000021C 0x00000000 
long 0xb0003028 0x094E7425

long 0xFF000000 0x56353557
long 0xFF000004 0x00353741
long 0xFF000008 0x30303030
long 0xFF00000C 0x30303030
long 0xFF000010 0x30303200
long 0xFF000014 0x31313037	
long 0xFF000018 0x32313031
long 0xFF00001C 0x30300030
long 0xFF000020 0x69570030	
long 0xFF000024 0x6E6F626E
long 0xFF000028 0x6C452064
long 0xFF00002C 0x72746365
long 0xFF000030 0x63696E6F
long 0xFF000034 0x6F432073
long 0xFF000038 0x00007072





